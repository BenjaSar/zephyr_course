## west_app/app/west.yml
```yaml
#Author: FS
#Based on the blog : https://interrupt.memfault.com/blog/practical_zephyr_west
manifest:
  version: 0.8

  self:
    path: app

  projects:
    - name: zephyr
      revision: v3.4.0
      url: https://github.com/zephyrproject-rtos/zephyr
      import:
        path-prefix: deps
        # the `file` key is not strictly needed since `west.yml` is the default value.
        file: west.yml
        name-allowlist:
          - cmsis
          - hal_nordic
```

## west_app/build/Kconfig/Kconfig.modules
```kconfig
menu "hal_nordic (/home/fsiof/course_zephyr/west_app/deps/modules/hal/nordic)"
osource "$(ZEPHYR_HAL_NORDIC_KCONFIG)"
config ZEPHYR_HAL_NORDIC_MODULE
	bool
	default y
endmenu
```
